## configs/firefly_rk3308_ext_release_defconfig
```kconfig
BR2_aarch64=y
BR2_cortex_a35=y
BR2_ARM_FPU_VFPV4=y
BR2_JLEVEL=24
BR2_SSP_STRONG=y
BR2_RELRO_PARTIAL=y
BR2_FORTIFY_SOURCE_2=y
BR2_TOOLCHAIN_BUILDROOT_VENDOR="rockchip"
BR2_TOOLCHAIN_BUILDROOT_GLIBC=y
BR2_KERNEL_HEADERS_4_4=y
BR2_TOOLCHAIN_BUILDROOT_CXX=y
BR2_GCC_ENABLE_OPENMP=y
BR2_PACKAGE_HOST_GDB=y
BR2_TARGET_GENERIC_HOSTNAME="ruishan"
BR2_TARGET_GENERIC_ISSUE="Welcome to Ruishan"
BR2_TARGET_GENERIC_PASSWD_SHA256=y
BR2_ROOTFS_DEVICE_CREATION_DYNAMIC_EUDEV=y
# BR2_TARGET_ENABLE_ROOT_LOGIN is not set
# BR2_TARGET_GENERIC_GETTY is not set
BR2_TARGET_TZ_INFO=y
BR2_TARGET_LOCALTIME="Asia/Shanghai"
BR2_ROOTFS_OVERLAY="board/rockchip/rk3308/fs-overlay"
BR2_PACKAGE_BUSYBOX_CONFIG="board/rockchip/rk3308/busybox.config"
BR2_PACKAGE_BUSYBOX_SHOW_OTHERS=y

# 开启SSH
BR2_PACKAGE_OPENSSH=y
BR2_TARGET_ENABLE_ROOT_LOGIN=y
BR2_TARGET_GENERIC_ROOT_PASSWD="RSyyds1688!"

# BASH SHELL
BR2_PACKAGE_BASH=y

# 守护进程
BR2_PACKAGE_SUPERVISOR=y
BR2_PACKAGE_PYTHON=y

BR2_PACKAGE_ROCKCHIP=y
BR2_PACKAGE_RK3308=y
BR2_PACKAGE_ADBD=y
BR2_PACKAGE_SOFTAPSERVER=y
BR2_PACKAGE_WIFIAUTOSETUP=y
BR2_PACKAGE_RKWIFIBT=y
BR2_PACKAGE_RKWIFIBT_RTL8188EU=y
BR2_PACKAGE_CYPRESS_BSA=y
BR2_PACKAGE_UPDATE=y
BR2_PACKAGE_IO=y
BR2_PACKAGE_VENDOR_STORAGE=y
BR2_PACKAGE_RKSCRIPT=y
BR2_PACKAGE_ANDROID_TOOLS_ADBD=y
BR2_PACKAGE_FIREFLY_CHOOSE_ROOTFS=y
BR2_PACKAGE_FIREFLY_EC200S=y
BR2_PACKAGE_FIREFLY_BRIDGE_NET=y
BR2_PACKAGE_FIREFLY_WIFI_TOOL=y
BR2_PACKAGE_STRACE=y
BR2_PACKAGE_E2FSPROGS=y
BR2_PACKAGE_E2FSPROGS_RESIZE2FS=y
BR2_PACKAGE_EXFAT=y
BR2_PACKAGE_MMC_UTILS=y
BR2_PACKAGE_NTFS_3G=y
BR2_PACKAGE_NTFS_3G_NTFSPROGS=y
BR2_PACKAGE_DBUS_GLIB=y
BR2_PACKAGE_EVTEST=y
BR2_PACKAGE_GPTFDISK=y
BR2_PACKAGE_GPTFDISK_SGDISK=y
BR2_PACKAGE_I2C_TOOLS=y
BR2_PACKAGE_INPUT_EVENT_DAEMON=y
BR2_PACKAGE_USBMOUNT=y
BR2_PACKAGE_CA_CERTIFICATES=y
BR2_PACKAGE_GNUTLS=y
BR2_PACKAGE_JSON_C=y
BR2_PACKAGE_GLIB_NETWORKING=y
BR2_PACKAGE_LIBCURL=y
BR2_PACKAGE_LIBNGHTTP2=y
BR2_PACKAGE_LIBMICROHTTPD=y
BR2_PACKAGE_PCRE_16=y
BR2_PACKAGE_BLUEZ5_UTILS=y
BR2_PACKAGE_CAN_UTILS=y
BR2_PACKAGE_DHCPCD=y
BR2_PACKAGE_DNSMASQ=y
# BR2_PACKAGE_DNSMASQ_TFTP is not set
BR2_PACKAGE_HOSTAPD=y
# BR2_PACKAGE_HOSTAPD_ACS is not set
BR2_PACKAGE_IPERF3=y
BR2_PACKAGE_IPROUTE2=y
BR2_PACKAGE_IPTABLES=y
BR2_PACKAGE_IW=y
BR2_PACKAGE_NTP=y
BR2_PACKAGE_NTP_SNTP=y
BR2_PACKAGE_NTP_NTPDATE=y
BR2_PACKAGE_NTP_NTPTIME=y
BR2_PACKAGE_WIRELESS_TOOLS=y
BR2_PACKAGE_WIRELESS_TOOLS_LIB=y
BR2_PACKAGE_WPA_SUPPLICANT=y
BR2_PACKAGE_WPA_SUPPLICANT_AUTOSCAN=y
BR2_PACKAGE_WPA_SUPPLICANT_CLI=y
BR2_PACKAGE_WPA_SUPPLICANT_WPA_CLIENT_SO=y
BR2_PACKAGE_WPA_SUPPLICANT_PASSPHRASE=y
BR2_PACKAGE_UTIL_LINUX_MOUNT=y
BR2_PACKAGE_UTIL_LINUX_RFKILL=y
BR2_TARGET_ROOTFS_EXT2=y
BR2_TARGET_ROOTFS_EXT2_2r0=y
BR2_TARGET_ROOTFS_EXT2_SIZE="256M"
BR2_TARGET_ROOTFS_SQUASHFS=y
# BR2_TARGET_ROOTFS_TAR is not set
BR2_PACKAGE_HOST_MKE2IMG=y
BR2_PACKAGE_HOST_VBOOT_UTILS=y
```
